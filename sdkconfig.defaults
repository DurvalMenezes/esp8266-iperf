## sdkconfig.defaults
```kconfig
#sdkconfig.defaults: options that `make menuconfig` will set by default

#Needed for all console commands
CONFIG_USING_ESP_CONSOLE=y

#Needed for the `tasks` and `wait` console commands
CONFIG_FREERTOS_USE_TRACE_FACILITY=y
CONFIG_FREERTOS_USE_STATS_FORMATTING_FUNCTIONS=y
CONFIG_FREERTOS_GENERATE_RUN_TIME_STATS=y
CONFIG_FREERTOS_RUN_TIME_STATS_USING_ESP_TIMER=y

#Needed for the `stats` console command
CONFIG_LWIP_STATS=y

#Eof sdkconfig.defaults
```
